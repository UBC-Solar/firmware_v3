/* USER CODE BEGIN Header */
/**
  ******************************************************************************
  * @file           : main.c
  * @brief          : Main program body
  ******************************************************************************
  * @attention
  *
  * Copyright (c) 2025 STMicroelectronics.
  * All rights reserved.
  *
  * This software is licensed under terms that can be found in the LICENSE file
  * in the root directory of this software component.
  * If no LICENSE file comes with this software, it is provided AS-IS.
  *
  ******************************************************************************
  */
/* USER CODE END Header */
/* Includes ------------------------------------------------------------------*/
#include "main.h"
#include "spi.h"
#include "gpio.h"

/* Private includes ----------------------------------------------------------*/
/* USER CODE BEGIN Includes */

/* USER CODE END Includes */

/* Private typedef -----------------------------------------------------------*/
/* USER CODE BEGIN PTD */

/* USER CODE END PTD */

/* Private define ------------------------------------------------------------*/
/* USER CODE BEGIN PD */

/* USER CODE END PD */

/* Private macro -------------------------------------------------------------*/
/* USER CODE BEGIN PM */

/* USER CODE END PM */

/* Private variables ---------------------------------------------------------*/

/* USER CODE BEGIN PV */
unsigned char NHD[] = {
    0x00, 0x00, 0x00, 0x00, 0x00, 0x00, 0x00, 0x00, 0x00, 0x00, 0x00, 0x00, 0x00, 0x00, 0x00, 0x00,
    0x00, 0x00, 0x00, 0x00, 0x00, 0x00, 0x00, 0x00, 0x00, 0x00, 0x00, 0x00, 0x00, 0x00, 0x00, 0x00,
    0x00, 0x00, 0x00, 0x00, 0x00, 0x00, 0x00, 0x00, 0x00, 0x00, 0x00, 0x00, 0x00, 0x00, 0x00, 0x00,
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    0x00, 0x00, 0x00, 0x00, 0x00, 0x00, 0x00, 0x00, 0x00, 0x00, 0x00, 0x00, 0x00, 0x00, 0x00, 0x00};
/* USER CODE END PV */

/* Private function prototypes -----------------------------------------------*/
void SystemClock_Config(void);
/* USER CODE BEGIN PFP */
void comm_write(uint8_t command);
void test_display_toggle();
void setup_display();
void data_write(uint8_t d);
void DispPic(uint8_t *lcd_string);
void ClearLCD(uint8_t *lcd_string);
/* USER CODE END PFP */

/* Private user code ---------------------------------------------------------*/
/* USER CODE BEGIN 0 */

/* USER CODE END 0 */

/**
  * @brief  The application entry point.
  * @retval int
  */
int main(void)
{

  /* USER CODE BEGIN 1 */

  /* USER CODE END 1 */

  /* MCU Configuration--------------------------------------------------------*/

  /* Reset of all peripherals, Initializes the Flash interface and the Systick. */
  HAL_Init();

  /* USER CODE BEGIN Init */

  /* USER CODE END Init */

  /* Configure the system clock */
  SystemClock_Config();

  /* USER CODE BEGIN SysInit */

  /* USER CODE END SysInit */

  /* Initialize all configured peripherals */
  MX_GPIO_Init();
  MX_SPI2_Init();
  /* USER CODE BEGIN 2 */

	  // Configure GPIOs as output (already set in CubeMX for HAL)
	  HAL_GPIO_WritePin(RESET_GPIO_Port, RESET_Pin, GPIO_PIN_RESET);
	  HAL_Delay(100); // Wait 100 ms
	  HAL_GPIO_WritePin(RESET_GPIO_Port, RESET_Pin, GPIO_PIN_SET);
	  HAL_Delay(100); // Wait another 100 ms

	  setup_display();

	  HAL_GPIO_WritePin(CS_GPIO_Port, CS_Pin, GPIO_PIN_SET);    // Chip Select High

	  HAL_GPIO_WritePin(LED_GPIO_Port, LED_Pin, GPIO_PIN_RESET);
  /* USER CODE END 2 */

  /* Infinite loop */
  /* USER CODE BEGIN WHILE */
  while (1)
  {
	     ClearLCD(NHD); // clear LCD
	     HAL_Delay(1000);
	     DispPic(NHD); // Show Image
	     HAL_Delay(3000);
	     comm_write(0xA5); // Turn all points ON
	     HAL_Delay(1000);
	     comm_write(0xA4); // Revert to Normal Display
	     HAL_Delay(1000);
    /* USER CODE END WHILE */

    /* USER CODE BEGIN 3 */
  }
  /* USER CODE END 3 */
}

/**
  * @brief System Clock Configuration
  * @retval None
  */
void SystemClock_Config(void)
{
  RCC_OscInitTypeDef RCC_OscInitStruct = {0};
  RCC_ClkInitTypeDef RCC_ClkInitStruct = {0};

  /** Initializes the RCC Oscillators according to the specified parameters
  * in the RCC_OscInitTypeDef structure.
  */
  RCC_OscInitStruct.OscillatorType = RCC_OSCILLATORTYPE_HSI;
  RCC_OscInitStruct.HSIState = RCC_HSI_ON;
  RCC_OscInitStruct.HSICalibrationValue = RCC_HSICALIBRATION_DEFAULT;
  RCC_OscInitStruct.PLL.PLLState = RCC_PLL_ON;
  RCC_OscInitStruct.PLL.PLLSource = RCC_PLLSOURCE_HSI_DIV2;
  RCC_OscInitStruct.PLL.PLLMUL = RCC_PLL_MUL16;
  if (HAL_RCC_OscConfig(&RCC_OscInitStruct) != HAL_OK)
  {
    Error_Handler();
  }

  /** Initializes the CPU, AHB and APB buses clocks
  */
  RCC_ClkInitStruct.ClockType = RCC_CLOCKTYPE_HCLK|RCC_CLOCKTYPE_SYSCLK
                              |RCC_CLOCKTYPE_PCLK1|RCC_CLOCKTYPE_PCLK2;
  RCC_ClkInitStruct.SYSCLKSource = RCC_SYSCLKSOURCE_PLLCLK;
  RCC_ClkInitStruct.AHBCLKDivider = RCC_SYSCLK_DIV1;
  RCC_ClkInitStruct.APB1CLKDivider = RCC_HCLK_DIV2;
  RCC_ClkInitStruct.APB2CLKDivider = RCC_HCLK_DIV1;

  if (HAL_RCC_ClockConfig(&RCC_ClkInitStruct, FLASH_LATENCY_2) != HAL_OK)
  {
    Error_Handler();
  }
}

/* USER CODE BEGIN 4 */
// Function to send a command via SPI
void comm_write(uint8_t cmd)
{
    HAL_GPIO_WritePin(CS_GPIO_Port, CS_Pin, GPIO_PIN_RESET);  // Chip Select Low
    HAL_GPIO_WritePin(A0_GPIO_Port, A0_Pin, GPIO_PIN_RESET);  // A0 = 0 for command

    // Send the command byte via SPI
    HAL_StatusTypeDef return_value = HAL_SPI_Transmit(&hspi2, (uint8_t *) &cmd, 1, HAL_MAX_DELAY);

    if(return_value == HAL_OK){
       	HAL_GPIO_TogglePin(LED_GPIO_Port, LED_Pin);
    }

    HAL_GPIO_WritePin(CS_GPIO_Port, CS_Pin, GPIO_PIN_SET);    // Chip Select High
}



// Main function to test toggling points
void test_display_toggle() {
    // Turn all points ON
    comm_write(0xAF);
    HAL_Delay(1000); // Delay for 1 second

    // Revert to Normal Display
    comm_write(0xAE);
    HAL_Delay(1000); // Delay for 1 second
}

void setup_display()
{
    // ADC Select
    comm_write(0xA0); // A0 = 0 for command

    // Display OFF
    comm_write(0xAE);

    // COM Direction Scan
    comm_write(0xC8);

    // LCD Bias Set
    comm_write(0xA2);

    // Power Control Set
    comm_write(0x2F);

    // Resistor Ratio Set
    comm_write(0x26);

    // Electronic Volume Command (Set Contrast)
    comm_write(0x81);

    // Electronic Volume Value (Contrast Value)
    comm_write(0x11);

    // Display ON
    comm_write(0xAF);
}

void data_write(uint8_t data)
{
    HAL_GPIO_WritePin(CS_GPIO_Port, CS_Pin, GPIO_PIN_RESET);  // Chip Select Low
    HAL_GPIO_WritePin(A0_GPIO_Port, A0_Pin, GPIO_PIN_SET);    // A0 = 1 for data

    // Send the data byte via SPI
    HAL_StatusTypeDef return_value = HAL_SPI_Transmit(&hspi2, (uint8_t *) &data, 1, HAL_MAX_DELAY);

    if(return_value == HAL_OK){
      HAL_GPIO_TogglePin(LED_GPIO_Port, LED_Pin);
    }

    HAL_GPIO_WritePin(CS_GPIO_Port, CS_Pin, GPIO_PIN_SET);    // Chip Select High
}


void DispPic(uint8_t *lcd_string)
{
    uint8_t i, j;
    uint8_t page = 0xB0; // Start at page 0xB0

    comm_write(0xAE); // Display OFF
    comm_write(0x40); // Display start address + 0x40

    for (i = 0; i < 8; i++) // 64-pixel display height / 8 pixels per page = 8 pages
    {
        comm_write(page); // Send page address
        comm_write(0x10); // Set column address upper 4 bits + 0x10
        comm_write(0x00); // Set column address lower 4 bits + 0x00

        for (j = 0; j < 128; j++) // 128 columns wide
        {
            data_write(*lcd_string); // Send picture data byte by byte
            lcd_string++;            // Move to the next byte in the image data
        }

        page++; // After completing one page (128 columns), move to the next
    }

    comm_write(0xAF); // Display ON
}

void ClearLCD(uint8_t *lcd_string)
{
    uint8_t i, j;
    uint8_t page = 0xB0; // Start at page 0xB0

    comm_write(0xAE); // Display OFF
    comm_write(0x40); // Display start address + 0x40

    for (i = 0; i < 8; i++) // 64-pixel display height / 8 pixels per page = 8 pages
    {
        comm_write(page); // Send page address
        comm_write(0x10); // Set column address upper 4 bits + 0x10
        comm_write(0x00); // Set column address lower 4 bits + 0x00

        for (j = 0; j < 128; j++) // 128 columns wide
        {
            data_write(0x00); // Write 0x00 (clear pixels)
            lcd_string++;     // Increment the buffer pointer (optional)
        }

        page++; // Move to the next page
    }

    comm_write(0xAF); // Display ON
}





/* USER CODE END 4 */

/**
  * @brief  This function is executed in case of error occurrence.
  * @retval None
  */
void Error_Handler(void)
{
  /* USER CODE BEGIN Error_Handler_Debug */
  /* User can add his own implementation to report the HAL error return state */
  __disable_irq();
  while (1)
  {
  }
  /* USER CODE END Error_Handler_Debug */
}

#ifdef  USE_FULL_ASSERT
/**
  * @brief  Reports the name of the source file and the source line number
  *         where the assert_param error has occurred.
  * @param  file: pointer to the source file name
  * @param  line: assert_param error line source number
  * @retval None
  */
void assert_failed(uint8_t *file, uint32_t line)
{
  /* USER CODE BEGIN 6 */
  /* User can add his own implementation to report the file name and line number,
     ex: printf("Wrong parameters value: file %s on line %d\r\n", file, line) */
  /* USER CODE END 6 */
}
#endif /* USE_FULL_ASSERT */
